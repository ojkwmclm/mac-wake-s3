## main/Kconfig.projbuild
```kconfig
menu "Mac Wake S3"
    config WAKE_WIFI_SSID
        string "2.4 GHz Wi-Fi SSID (empty = button only)"
        default ""
    config WAKE_WIFI_PASSWORD
        string "Wi-Fi password"
        default ""
    config WAKE_BLINKER_KEY
        string "Blinker independent-device Auth Key (empty disables cloud)"
        default ""
    config WAKE_SEND_SHIFT
        bool "Send a Shift press/release after resume or when USB is active"
        default n
        help
            Optional fallback. Default only sends USB remote resume.
            Enable only after testing; this can affect a foreground application.
    config WAKE_HEALTH_RESET
        bool "EXPERIMENTAL: watchdog for stopped USB/button workers"
        depends on ESP_TASK_WDT_EN && ESP_TASK_WDT_INIT && ESP_TASK_WDT_PANIC
        default n
        help
            Uses an IDF TWDT user; cloud offline never stops feeding.
            Default disabled until controlled reset validation passes.
    config WAKE_HEALTH_RESET_TEST
        bool "TEST ONLY: one-shot persistent 180s USB worker stop"
        depends on WAKE_HEALTH_RESET
        default n
        help
            Commits an NVS one-shot marker before stopping the USB worker.
            A reset must not re-arm this test. Dedicated local test image only.
    config WAKE_HEALTH_FAULT_TEST
        bool "TEST ONLY: pause USB worker 60s once after 60s uptime"
        depends on !WAKE_HEALTH_RESET_TEST
        default n
        help
            Dedicated diagnostic image. Keeps yielding CPU, allowing cloud and
            supervisor to run. Sleep/wake requests pause for up to one minute.
            Automatically recovers. Never enable for unattended normal use.
endmenu
```

## sdkconfig.defaults
```kconfig
CONFIG_IDF_TARGET="esp32s3"
CONFIG_ESPTOOLPY_FLASHSIZE_16MB=y
CONFIG_TINYUSB_HID_COUNT=2
CONFIG_TINYUSB_CDC_ENABLED=n
CONFIG_ESP_CONSOLE_UART_DEFAULT=y
CONFIG_ESP_CONSOLE_USB_SERIAL_JTAG=n
CONFIG_COMPILER_OPTIMIZATION_SIZE=y
CONFIG_MBEDTLS_CERTIFICATE_BUNDLE=y
CONFIG_MBEDTLS_CERTIFICATE_BUNDLE_DEFAULT_FULL=y
CONFIG_MQTT_TRANSPORT_SSL=y
CONFIG_MQTT_TRANSPORT_WEBSOCKET=y
CONFIG_MQTT_TRANSPORT_WEBSOCKET_SECURE=y
CONFIG_PARTITION_TABLE_CUSTOM=y
CONFIG_PARTITION_TABLE_CUSTOM_FILENAME="partitions.csv"

CONFIG_LWIP_SNTP_MAX_SERVERS=2

# Explicitly preserve the settings of the reviewed physical baseline.
CONFIG_WAKE_SEND_SHIFT=y
CONFIG_ESP_INT_WDT=y
CONFIG_ESP_INT_WDT_TIMEOUT_MS=300
CONFIG_ESP_INT_WDT_CHECK_CPU1=y
CONFIG_ESP_TASK_WDT_EN=y
CONFIG_ESP_TASK_WDT_INIT=y
CONFIG_ESP_TASK_WDT_TIMEOUT_S=60
CONFIG_ESP_TASK_WDT_CHECK_IDLE_TASK_CPU0=y
CONFIG_ESP_TASK_WDT_CHECK_IDLE_TASK_CPU1=y
CONFIG_ESP_TASK_WDT_PANIC=y
CONFIG_ESP_SYSTEM_PANIC_PRINT_REBOOT=y

CONFIG_WAKE_HEALTH_RESET=y
# CONFIG_WAKE_HEALTH_RESET_TEST is not set
# CONFIG_WAKE_HEALTH_FAULT_TEST is not set
```
